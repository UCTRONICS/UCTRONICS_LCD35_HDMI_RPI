/dts-v1/;

/ {
	compatible = "brcm,bcm2835\0brcm,bcm2708\0brcm,bcm2709";

	fragment@0 {
		target = < 0xdeadbeef >;

		__overlay__ {
			status = "okay";

			spidev@0 {
				status = "disabled";
			};

			spidev@1 {
				status = "disabled";
			};
		};
	};

	fragment@1 {
		target = < 0xdeadbeef >;

		__overlay__ {
			#address-cells = < 0x01 >;
			#size-cells = < 0x00 >;
		    tft35a:tft35a@0 {
				compatible = "ti,ads7846";
				reg = < 0x00 >;
				spi-max-frequency = < 0x1e8480 >;
				interrupts = < 0x19 0x02 >;
				interrupt-parent = < 0xdeadbeef >;
				pendown-gpio = < 0xdeadbeef 0x19 0x00 >;
				ti,x-plate-ohms = [ 00 3c ];
				ti,pressure-max = [ 00 ff ];
        ti,swap-xy;
				ti,x-max = [ 0F 28 ];
				ti,y-min = [ 0F 60 ];
				ti,x-min = [ 01 0c ];
				ti,y-max = [ 00 E3 ];
				linux,phandle = < 0x03 >;
				phandle = < 0x03 >;
			};
		};
	};
	__symbols__ {
		tft35a = "/fragment@1/__overlay__/tft35a@0";
	};

	__fixups__ {
		spi0 = "/fragment@0:target:0\0/fragment@1:target:0";
		gpio = "/fragment@0:target:0\0/fragment@1/__overlay__/tft35a@0:interrupt-parent:0\0/fragment@1/__overlay__/tft35a@0:pendown-gpio:0";
	};
};
